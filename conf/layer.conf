## conf/layer.conf
```bitbake
# We are a simple layer
# Minimal example

# Name of the layer
LCONF_VERSION = "7"
LAYERSERIES_COMPAT_meta-flutter-task-app = "honister kirkstone warrior zeus"

BBPATH .= ":${LAYERDIR}"
BBFILES += "${LAYERDIR}/recipes-*/*/*.bb \
            ${LAYERDIR}/recipes-*/*/*.bbappend"
```
